#ifndef RGB_TEST_VECTORS_H
#define RGB_TEST_VECTORS_H

/*
 * Validation vectors for the RGB pixel CNN.
 *
 * WHY THIS EXISTS AT ALL: main.cpp's rgb_model_forward_timed() is a
 * buffer-hoisted mirror of model_weights.h's generated model_forward(). The
 * generated model_forward() cannot be called on this target under any
 * circumstances -- it declares ~619KB of intermediates as stack locals, more
 * than the ESP32-S3 has internal SRAM in total. So unlike the DCT firmware,
 * which diffed its instrumented mirror against the real model_forward() every
 * boot, there is no on-device reference here. The mirror's correctness has to
 * be established against the PC-side int8 reference instead, which means
 * transmitting expected outputs rather than computing them locally.
 *
 * THREE TIERS, in ascending order of how much they actually prove:
 *
 *  1. LCG noise (SYNTH_*) -- cheap smoke test, weak evidence. All four seeds
 *     pool to nearly the same feature vector and the same argmax, because
 *     white noise has no spatial structure to survive four convolutions and a
 *     global average pool. That makes these vectors nearly blind to the
 *     errors this mirror is actually most likely to contain: a row-pitch
 *     mistake, an off-by-one in padding, a stride-2 phase error, or a
 *     channel-plane indexing slip would all still average out to roughly the
 *     right pooled value. Passing these alone means very little.
 *
 *  2. Structured patterns (PATTERN_*) -- the PRIMARY check. Strong
 *     horizontal, vertical and blocky high-frequency structure with
 *     per-channel asymmetry, so the geometry errors above cannot average
 *     themselves out. CHECKER in particular saturates at both int8 rails; a
 *     transposed or misaligned mirror misses these by tens of LSB, not by
 *     rounding. Cost: three int8[MODEL_NUM_CLASSES] rows of flash, no image
 *     data.
 *
 *  3. Real images (REAL_*) -- end-to-end sanity, 115,200 bytes of flash. Two
 *     photographs the PC-side int8 model classifies CORRECTLY, chosen so that
 *     a mismatch here means the port is wrong rather than the model being
 *     wrong.
 *
 * All expected outputs were generated by running the int8 forward built
 * directly from output/rgb_cnn/quantized_model.npz -- the same arrays emitted
 * into model_weights.h -- and NOT from a recalibrated reference. That
 * distinction matters: recalibrating output_scale against a different
 * calibration set yields different mult/shift values and produces a spurious
 * verification failure against a header that is actually correct. Preserve
 * that property if these are ever regenerated (see
 * scratchpad/gen_rgb_test_vectors.py).
 *
 * Inputs everywhere are planar [3][MODEL_RGB_HEIGHT][MODEL_RGB_WIDTH], R plane then G then B, uint8
 * 0..255, fed in without pre-centering -- the model subtracts 128 itself.
 */

#include <stdint.h>

#include "rgb_synth_vectors.h"
#include "rgb_real_images.h"

/* Derived from the model's own input geometry, NOT hard-coded. These were
 * 3*120*160 while the model consumed full-resolution frames; once
 * train_rgb_cnn.py's --rgb-block-width/height reduced the input to 20x15 the
 * fixed size wrote 57,600 bytes into a 900-byte buffer, corrupting the heap and
 * boot-looping the device with StoreProhibited before a single line of serial
 * output. The Python generators already take (h, w) -- these must track them. */
#define SYNTH_RGB_BYTES (3 * MODEL_RGB_HEIGHT * MODEL_RGB_WIDTH)

/* Fills dst[SYNTH_RGB_BYTES] with the seeded LCG stream. Numerical Recipes
 * ranqd1 constants; the top byte of the state is taken because the low bits
 * of a power-of-two-modulus LCG have short periods.
 *
 * A flat loop over 3*H*W is exactly equivalent to the nested (c outer,
 * then y, then x) order the PC generator used, because the planar [3][H][W]
 * layout is contiguous in precisely that order. Same applies to
 * pattern_fill() below, which does use explicit indices since it needs x/y/c. */
static inline void synth_fill(uint32_t seed, uint8_t *dst) {
  uint32_t s = seed;
  for (int i = 0; i < SYNTH_RGB_BYTES; i++) {
    s = s * 1664525u + 1013904223u;
    dst[i] = (uint8_t)((s >> 24) & 0xFFu);
  }
}

static const char *const PATTERN_NAMES[PATTERN_NUM_VECTORS] = {"HRAMP", "VRAMP", "CHECKER"};

/* Must stay bit-identical to the formulas in scratchpad/gen_rgb_test_vectors.py.
 * Note the /8 is integer division. */
static inline void pattern_fill(int idx, uint8_t *dst) {
  for (int c = 0; c < 3; c++) {
    for (int y = 0; y < MODEL_RGB_HEIGHT; y++) {
      for (int x = 0; x < MODEL_RGB_WIDTH; x++) {
        int i = (c * MODEL_RGB_HEIGHT + y) * MODEL_RGB_WIDTH + x;
        switch (idx) {
          case 0: /* HRAMP */
            dst[i] = (uint8_t)((x * 2 + c * 40) & 0xFF);
            break;
          case 1: /* VRAMP */
            dst[i] = (uint8_t)((y * 3 + c * 70) & 0xFF);
            break;
          default: /* CHECKER */
            dst[i] = (uint8_t)(((x / 8 + y / 8) & 1) ? (c * 80 + 30) : (200 - c * 60));
            break;
        }
      }
    }
  }
}

#endif /* RGB_TEST_VECTORS_H */
